//Ultrasonic distance reader, using Talkie library and ultrasonic sensor for distance
//Enable pin for a switch/button to quickly turn on and off
//HMC5883 Magnetic sensor to give compass bearing

// Talkie library
// Copyright 2011 Peter Knight
// This code is released under GPLv2 license.
//
// The following phrases are derived from VM61002 ROM
//
// A male voice with a US accent.
//
// These phrases have a very military bias
// with lots of very useful engineering words.
// They also have good expression.
// 
// modified to work with newer Arduino versions (const modifier on PROGMEM)
// some phrases chopped for clarity- can be found in library

#include "talkie.h"
Talkie voice;

#include <Wire.h> //I2C Arduino Library
#include <math.h>;
#define address 0x1E // I2C 7bit address of HMC5883 magnetic sensor

uint8_t const spZERO[]          PROGMEM = {0x69,0xFB,0x59,0xDD,0x51,0xD5,0xD7,0xB5,0x6F,0x0A,0x78,0xC0,0x52,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0xFF,0x1F};
uint8_t const spFOUR[]          PROGMEM = {0x08,0x68,0x21,0x0D,0x03,0x04,0x28,0xCE,0x92,0x03,0x23,0x4A,0xCA,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0xF2,0xFF};
uint8_t const spEIGHT[]         PROGMEM = {0x65,0x69,0x89,0xC5,0x73,0x66,0xDF,0xE9,0x8C,0x33,0x0E,0x41,0xC6,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0xF8,0x7F};
uint8_t const spTWELVE[]        PROGMEM = {0x09,0x98,0xDA,0x22,0x01,0x37,0x78,0x1A,0x20,0x85,0xD1,0x50,0x3A,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0xFE,0x1F};
uint8_t const spONE[]           PROGMEM = {0x66,0x4E,0xA8,0x7A,0x8D,0xED,0xC4,0xB5,0xCD,0x89,0xD4,0xBC,0xA2,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0xFE,0x1F};
uint8_t const spFIVE[]          PROGMEM = {0x08,0x68,0x4E,0x9D,0x02,0x1C,0x60,0xC0,0x8C,0x69,0x12,0xB0,0xC0,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0xFF,0x01};
uint8_t const spNINE[]          PROGMEM = {0xE6,0xA8,0x1A,0x35,0x5D,0xD6,0x9A,0x35,0x4B,0x8C,0x4E,0x6B,0x1A,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0xFF,0x0F};
uint8_t const spTHIR_[]         PROGMEM = {0x04,0xA8,0xBE,0x5C,0x00,0xDD,0xA5,0x11,0xA0,0xFA,0x72,0x02,0x74,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0xFF,0x03};
uint8_t const spHUNDRED[]       PROGMEM = {0x04,0xC8,0x7E,0x5C,0x02,0x0A,0xA8,0x62,0x43,0x03,0xA7,0xA8,0x62,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0xF9,0x7F};
uint8_t const spTWO[]           PROGMEM = {0x06,0xB8,0x59,0x34,0x00,0x27,0xD6,0x38,0x60,0x58,0xD3,0x91,0x55,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0xFF,0x1F};
uint8_t const spSIX[]           PROGMEM = {0x04,0xF8,0xAD,0x4C,0x02,0x16,0xB0,0x80,0x06,0x56,0x35,0x5D,0xA8,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0xFF,0x01};
uint8_t const spTEN[]           PROGMEM = {0x0E,0x38,0x3C,0x2D,0x00,0x5F,0xB6,0x19,0x60,0xA8,0x90,0x93,0x36,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0xFF,0x03};
uint8_t const spFIF_[]          PROGMEM = {0x08,0x98,0x31,0x93,0x02,0x1C,0xE0,0x80,0x07,0x5A,0xD6,0x1C,0x6B,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0xFC,0x3F};
uint8_t const spTHOUSAND[]      PROGMEM = {0x0C,0xE8,0x2E,0xD4,0x02,0x06,0x98,0xD2,0x55,0x03,0x16,0x68,0x7D,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0xFF,0x0F};
uint8_t const spTHREE[]         PROGMEM = {0x0C,0xE8,0x2E,0x94,0x01,0x4D,0xBA,0x4A,0x40,0x03,0x16,0x68,0x69,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0xFF,0x03};
uint8_t const spSEVEN[]         PROGMEM = {0x0C,0xF8,0x5E,0x4C,0x01,0xBF,0x95,0x7B,0xC0,0x02,0x16,0xB0,0xC0,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0xFB,0x7F};
uint8_t const spELEVEN[]        PROGMEM = {0xA5,0xEF,0xD6,0x50,0x3B,0x67,0x8F,0xB9,0x3B,0x23,0x49,0x7F,0x33,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0xFF,0x0F};
uint8_t const sp_TEEN[]         PROGMEM = {0x09,0x58,0x2A,0x25,0x00,0xCB,0x9F,0x95,0x6C,0x14,0x21,0x89,0xA9,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0xFF,0x3F};
uint8_t const spMILLION[] PROGMEM = {0x69,0xCE,0x5C,0x74,0xD4,0x9A,0xF6,0xF1,0xF4,0x83,0x9B,0x98,0xF9,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0xFE,0x1F};
uint8_t const spTWENTY[] PROGMEM = {0x0A,0xE8,0x4A,0xCD,0x01,0xDB,0xB9,0x33,0xC0,0xA6,0x54,0x0C,0xA4,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0xFF,0x1F};
uint8_t const spTHIRTY[] PROGMEM = {0x02,0x18,0xA2,0x52,0x02,0x16,0x60,0xC0,0x50,0x13,0x25,0x6B,0x2C,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0xFF,0x0F};
uint8_t const spFOURTY[] PROGMEM = {0x04,0xC8,0xCE,0x8C,0x01,0xCB,0x94,0x33,0x60,0xDA,0x0C,0x01,0x0C,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0xFF,0x01};
uint8_t const spFIFTY[] PROGMEM = {0x08,0x68,0x3A,0x05,0x01,0x5D,0xA4,0x12,0x60,0xD8,0x0A,0x02,0x4C,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0xFD,0xFF};
uint8_t const spSIXTY[] PROGMEM = {0x06,0x78,0x90,0xC4,0x00,0x3F,0x66,0x18,0xE0,0xA7,0x8C,0x04,0x7C,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0xFF,0x0F};
uint8_t const spSEVENTY[] PROGMEM = {0x0C,0xF8,0x29,0x45,0x01,0xBF,0x95,0x5A,0x20,0x00,0xBF,0xA5,0x3A,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0xFA,0x7F};
uint8_t const spEIGHTY[] PROGMEM = {0x63,0xEA,0xD2,0x28,0x37,0x67,0xAD,0x7E,0xF9,0x26,0xAC,0x58,0xB3,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0xFF,0x0F};
uint8_t const spNINETY[] PROGMEM = {0x6E,0x28,0x1C,0xE3,0x38,0xB4,0xB8,0x3E,0x33,0xAA,0xE5,0xF0,0xB2,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0xFF,0x01};
uint8_t const spFEET[]          PROGMEM = {0x08,0x98,0x31,0x93,0x02,0x1C,0xE0,0x80,0x07,0x5A,0x3E,0x4A,0x28,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0xFF,0x01};
uint8_t const spAND[]           PROGMEM = {0xA9,0x6B,0x21,0xB9,0x22,0x66,0x9F,0xAE,0xC7,0xE1,0x70,0x7B,0x72,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0xFF,0x3F};
uint8_t const spERROR2[] PROGMEM = {0x6D,0x6C,0x6E,0x89,0x5B,0x36,0x8F,0xA9,0x9B,0x11,0x5A,0xE9,0x33,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0xFF,0x3F};
uint8_t const spNEGATIVE[] PROGMEM = {0x66,0x88,0x82,0x3A,0xDD,0xE3,0x84,0x31,0x4B,0x6C,0x0F,0x4F,0x9C,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0xFB,0x7F};
uint8_t const spMINUS[] PROGMEM = {0x6A,0xCE,0x8C,0xF4,0xD4,0x93,0x86,0xA5,0x49,0xE2,0x31,0x73,0x1B,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0xFF,0x03};
uint8_t const spPOINT[] PROGMEM = {0x0A,0xC8,0x2E,0x8C,0x01,0xD1,0x85,0x95,0x34,0x8B,0xAA,0x74,0x56,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0xFB,0x7F};
uint8_t const sp_Z[] PROGMEM = {0x69,0x5F,0x30,0xC4,0x4C,0x77,0xE7,0x33,0x5C,0x5F,0x89,0x99,0xAA,0xBB,0xF8,0x08,0xE0,0x37,0x57,0x0E,0x50,0x80,0x02,0x0F};
uint8_t const spCENT[] PROGMEM = {0x0E,0xF8,0xA5,0xD5,0x02,0x16,0xB0,0x80,0x06,0x3C,0xB0,0xEA,0xE6,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0xD4,0x07};
uint8_t const spCENTI[] PROGMEM = {0x0E,0xF8,0xA5,0xD5,0x02,0x16,0xB0,0x80,0x06,0x3C,0xB0,0xEA,0xE6,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0x77,0xFF};
uint8_t const spMETER[]         PROGMEM = {0xA1,0x8F,0x5C,0xB5,0x56,0x92,0xE4,0xE1,0xF4,0xDD,0x0B,0x59,0x6B,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0xFF,0x0F};

uint8_t const spEAST[] PROGMEM = {0xAD,0x9A,0xD1,0x10,0xAB,0xE7,0x8C,0x62,0x25,0x43,0x8C,0x5E,0x32,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0xFF,0x01};
uint8_t const spWEST[] PROGMEM = {0x6C,0x65,0x7E,0xD3,0xCD,0x1C,0x8B,0x83,0xBA,0x4B,0x37,0xB3,0xC3,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0xFB,0x7F};
uint8_t const spSOUTH[] PROGMEM = {0x0C,0x78,0xC6,0x95,0x01,0x3F,0xA5,0x28,0xE0,0xB7,0x52,0x0B,0x04,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0xFF,0x03};
uint8_t const spNORTH[] PROGMEM = {0x6E,0x4A,0x9C,0x62,0x4A,0xEB,0x84,0xA5,0x08,0xD2,0x2E,0x69,0x92,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0xFB,0x7F};
uint8_t const spNORTHEAST[] PROGMEM = {0x66,0x4E,0x92,0xBD,0x43,0x67,0xBB,0x35,0x4A,0xAA,0xF4,0x68,0x1C,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0xFF,0x07};
uint8_t const spNORTHWEST[] PROGMEM = {0x2A,0x4D,0x9C,0x7D,0x4A,0xE2,0x84,0x35,0x49,0xCA,0x34,0xAB,0xDD,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0xF1,0xFF};
uint8_t const spSOUTHEAST[] PROGMEM = {0x0C,0x78,0xC6,0x95,0x01,0x3F,0xA5,0x28,0xE0,0xB7,0x52,0x0B,0x04,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0xFF,0x07};
uint8_t const spSOUTHWEST[] PROGMEM = {0x0C,0xB8,0x5E,0x92,0x01,0xCF,0xB8,0x32,0xE0,0xA7,0x14,0x05,0xFC,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0xF8,0x7F};

// Ultrasonic HC-SR04 unit interface
//define pins here
#define TRIG 9
#define ECHO 10

//control button
#define BUTTON 13

long i;
void setup() {
  //  Serial.begin(115200);    //can be uncommented for debugging
  usonicsetup();
  pinMode(8,OUTPUT);            //ultrasonic uses D8 and D11 for power
  digitalWrite(8,HIGH);
  pinMode(11,OUTPUT);
  digitalWrite(11,LOW);
  pinMode(BUTTON,INPUT_PULLUP);    //pullup input so it defaults to off
  //Put the HMC5883 IC into the correct operating mode
  Wire.begin();
  Wire.beginTransmission(address); //open communication with HMC5883
  Wire.write(0x02); //select mode register
  Wire.write(0x00); //continuous measurement mode
  Wire.endTransmission();
}

void loop() {
if(!digitalRead(BUTTON)){      //check if button pressed
  int x,y,z; //triple axis data
  double angle;  //angle
  int theta;    //int angle for mod operations
  //Tell the HMC5883L where to begin reading data
  Wire.beginTransmission(address);
  Wire.write(0x03); //select register 3, X MSB register
  Wire.endTransmission();
  //Read data from each axis, 2 registers per axis
  Wire.requestFrom(address, 6);
  if(6<=Wire.available()){
    x = Wire.read()<<8; //X msb
    x |= Wire.read(); //X lsb
    z = Wire.read()<<8; //Z msb
    z |= Wire.read(); //Z lsb
    y = Wire.read()<<8; //Y msb
    y |= Wire.read(); //Y lsb
  }
  if((x!=0)&&(y!=0)&&(z!=0)){    //check if valid data
    angle=atan2(y,x);            //convert to angle- x-axis points to calculated direction
    angle=angle*180/M_PI;        //convert to degrees
    theta=angle;                  //put in int to do modulo arithmetic
    //read out compass dir
    switch (((theta+382)/45)%8){      //add 360 to make sure it's +ve, +22 to centre in octant
    case 0:    voice.say(spNORTH);    break;
    case 1:    voice.say(spNORTHEAST);    break;
    case 2:    voice.say(spEAST);    break;
    case 3:    voice.say(spSOUTHEAST);    break;
    case 4:    voice.say(spSOUTH);    break;
    case 5:    voice.say(spSOUTHWEST);    break;
    case 6:    voice.say(spWEST);    break;
    case 7:    voice.say(spNORTHWEST);    break;
    }
  }
  else{ }//say nothing if error
    delay(150);            //brief delay between compass and distance

    i=usonic(174000)/58;  // distance in cm, max 300cm
    if(i==0){i=300;}  
    i=i/10;                //convert to 1/10 metre
    readnumber(i/10);
    voice.say(spPOINT);
    readnumber(i%10);
    voice.say(spMETER);
    voice.say(sp_Z);
    delay(300);            //delay before starting again
  }
}

void readnumber(long i){      //read out i 
  int zerosuppress=0;    //so we don't say three hundred and thirty zero
  if(i<0){voice.say(spMINUS);i=-i;}

  if(i>999999){
    readnumber(i/1000000L);
    voice.say(spMILLION);
    i=i%1000000;
    zerosuppress=1;
  }

  if(i>999){
    readnumber(i/1000);
    voice.say(spTHOUSAND);
    i=i%1000;
    zerosuppress=1;
  }

  if(i>99){
    readnumber(i/100);
    voice.say(spHUNDRED);
    i=i%100;
    zerosuppress=1;
  }

  if((zerosuppress)&&(i)){voice.say(spAND);}  //delete for American pronuncation
    
  if(i>19){
    switch(i/10){
    case 2:    voice.say(spTWENTY);    break;
    case 3:    voice.say(spTHIRTY);    break;
    case 4:    voice.say(spFOURTY);    break;
    case 5:    voice.say(spFIFTY);    break;
    case 6:    voice.say(spSIXTY);    break;
    case 7:    voice.say(spSEVENTY);    break;
    case 8:    voice.say(spEIGHTY);    break;
    case 9:    voice.say(spNINETY);    break;
    }
    i=i%10;
    zerosuppress=1;
  }    
  switch(i){
  case 0:    if(!zerosuppress){voice.say(spZERO);}    break;
  case 1:    voice.say(spONE);    break;
  case 2:    voice.say(spTWO);    break;
  case 3:    voice.say(spTHREE);    break;
  case 4:    voice.say(spFOUR);    break;
  case 5:    voice.say(spFIVE);    break;
  case 6:    voice.say(spSIX);    break;
  case 7:    voice.say(spSEVEN);    break;
  case 8:    voice.say(spEIGHT);    break;
  case 9:    voice.say(spNINE);    break;
  case 10:    voice.say(spTEN);    break;
  case 11:    voice.say(spELEVEN);    break;
  case 12:    voice.say(spTWELVE);    break;
  case 13:    voice.say(spTHIR_);voice.say(sp_TEEN);    break;
  case 14:    voice.say(spFOUR);voice.say(sp_TEEN);    break;
  case 15:    voice.say(spFIF_);voice.say(sp_TEEN);    break;
  case 16:    voice.say(spSIX);voice.say(sp_TEEN);    break;
  case 17:    voice.say(spSEVEN);voice.say(sp_TEEN);    break;
  case 18:    voice.say(spEIGHT);voice.say(sp_TEEN);    break;
  case 19:    voice.say(spNINE);voice.say(sp_TEEN);    break;
}

}
void usonicsetup(void){
  pinMode(ECHO, INPUT);
  pinMode(TRIG, OUTPUT);
  digitalWrite(TRIG, LOW);
}

long usonic(long utimeout){    //utimeout is maximum time to wait for return in us
  long b;
  if(digitalRead(ECHO)==HIGH){return 0;}    //if echo line is still low from last result, return 0;
  digitalWrite(TRIG, HIGH);  //send trigger pulse
  delay(1);
  digitalWrite(TRIG, LOW);
  long utimer=micros();
  while((digitalRead(ECHO)==LOW)&&((micros()-utimer)<1000)){}  //wait for pin state to change- return starts after 460us typically
  utimer=micros();
  while((digitalRead(ECHO)==HIGH)&&((micros()-utimer)<utimeout)){}  //wait for pin state to change
  b=micros()-utimer;
  return b;
}
